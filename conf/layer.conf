## conf/layer.conf
```bitbake
# We have a conf and classes directory, append to BBPATH
BBPATH .= ":${LAYERDIR}"

# We have a recipes directory, add to BBFILES
BBFILES += "${LAYERDIR}/recipes*/*/*.bb ${LAYERDIR}/recipes*/*/*.bbappend ${LAYERDIR}/images/*.bb "

BBFILE_COLLECTIONS += "meta-audiosystem"
BBFILE_PATTERN_meta-audiosystem := "^${LAYERDIR}/"
BBFILE_PRIORITY_meta-audiosystem = "11"

LAYERSERIES_COMPAT_meta-audiosystem = "sumo"
```
